## west.yml
```yaml
manifest:
  defaults:
    remote: github
    revision: main
  
  remotes:
    - name: github
      url-base: git@github.com:victorandrehc
    - name: upstream
      url-base: https://github.com/zephyrproject-rtos
  
  projects:
    - name: zephyr
      repo-path: zephyr.git
      revision: main
      path: zephyr
      west-commands: scripts/west-commands.yml
  
  #libs
    - name: telemetry_lib
      repo-path: telemetry_lib.git
      revision: main
      path: libs/telemetry
  
  #apps
    - name: telemetry_sample
      repo-path: telemetry_sample.git
      revision: main
      path: apps/telemetry_sample
  
  
  self:
    path: manifests/victorandrehc-manifest
```
